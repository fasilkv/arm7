#include"header.h"
#include"font.h"

#define oled_address 0x7A

void oled_Command(char DATA) /* Function for sending command to oled */
{
	i2c_write_frame(oled_address,0x00,DATA);	
}



void oled_init(void) /* Function for initializing oled */
{
  oled_Command(0xAE); /* Entire Display OFF */
	oled_Command(0xD5); /* Set Display Clock Divide Ratio and Oscillator Frequency */
  oled_Command(0x80); /* Default Setting for Display Clock Divide Ratio and Oscillator Frequency that is recommended */
  oled_Command(0xA8); /* Set Multiplex Ratio */
  oled_Command(0x3F); /* 64 COM lines */
  oled_Command(0xD3); /* Set display offset */
  oled_Command(0x00); /* 0 offset */
  oled_Command(0x40); /* Set first line as the start line of the display */
  oled_Command(0x8D); /* Charge pump */
  oled_Command(0x14); /* Enable charge dump during display on */
  oled_Command(0x20); /* Set memory addressing mode */
  oled_Command(0x00); /* Horizontal addressing mode */
  oled_Command(0xA1); /* Set segment remap with column address 127 mapped to segment 0 */
  oled_Command(0xC8); /* Set com output scan direction, scan from com63 to com 0 */
  oled_Command(0xDA); /* Set com pins hardware configuration */
  oled_Command(0x12); /* Alternative com pin configuration, disable com left/right remap */
  oled_Command(0x81); /* Set contrast control */
  oled_Command(0xCF); /* Set Contrast to 128 */
  oled_Command(0xD9); /* Set pre-charge period */
  oled_Command(0xF1); /* Phase 1 period of 15 DCLK, Phase 2 period of 1 DCLK */
  oled_Command(0xDB); /* Set Vcomh deselect level */
  oled_Command(0x40); /* Vcomh deselect level ~ 0.77 Vcc */
  oled_Command(0xA4); /* Entire display ON, resume to RAM content display */
  oled_Command(0xA6); /* Set Display in Normal Mode, 1 = ON, 0 = OFF */
  oled_Command(0x2E); /* Deactivate scroll */
  oled_Command(0xAF); /* Display on in normal mode */
}

void oled_print(char *DATA) /* Function for sending data to oled */
{
	//oled_Command(0xAE); /* Entire Display OFF */
	char *ptr = DATA;
	int len=0;
	while(*ptr)
	{
		len++;
		ptr++;
	}
  for (int g=0; g<len; g++)
  {    
			i2c_start();
			i2c_write(oled_address); /* Begin transmission to slave device */  
			i2c_write(0x40); /* For Data Transmission, C = 0 and D/C = 1 */ 
    for (int index=0; index<5; index++)
    {     
      i2c_write(ASCII[DATA[g] - 0x20][index]); 
    }
		delay_ms(10);
     i2c_stop(); /* Transmit the queued bytes and end transmission to slave device */ 
      
  }
}

void oled_setXY(char col_start, char col_end, char page_start, char page_end) /* Function for setting cursor for writing data */  
{
	i2c_start();
	i2c_write(oled_address); /* Begin transmission to slave device */
  i2c_write(0x00); /* For Data Transmission, C = 0 and D/C = 0 */
  i2c_write(0x21); /* Set Column Start and End Address */ 
  i2c_write(col_start); /* Column Start Address col_start */
  i2c_write(col_end); /* Column End Address col_end */
  i2c_write(0x22); /* Set Page Start and End Address */ 
  i2c_write(page_start); /* Page Start Address page_start */
  i2c_write(page_end); /* Page End Address page_end */
  i2c_stop(); /* Transmit the queued bytes and end transmission to slave device */
}

void oled_clear(void) /* Function for clearing oled */   
{
  oled_setXY(0x00, 0x7F, 0x00, 0x07); /* Column Start Address 0, Column End Address 127, Page Start Address 0, Page End Address 7  */
			i2c_start();
			i2c_write(oled_address); /* Begin transmission to slave device */
			/* Queue data to be transmitted */
			i2c_write(0x40); /* For Data Transmission, C = 0 and D/C = 1 */ 
    
  for (int k=0; k<=1023; k++)
  {
		i2c_write(0x00);
  } 
	delay_ms(10);
  i2c_stop(); /* Transmit the queued bytes and end transmission to slave device */  
  
}

///////////////////////////////////////////////////////////////////////

#define SSD1306_128_64

#define SSD1306_COLUMNADDR           0x21
#define SSD1306_PAGEADDR             0x22

const char Font[] = {
0x00, 0x00, 0x00, 0x00, 0x00,
0x00, 0x00, 0x5F, 0x00, 0x00,
0x00, 0x07, 0x00, 0x07, 0x00,
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0x02, 0x01, 0x02, 0x04, 0x02
};


uint8_t x_pos,y_pos,wrap=1;
void oled_gotoxy2(uint8_t x, uint8_t y) {
  if((x > (128 / 6)) || y > (64 / 8))
    return;
  x_pos = x;
  y_pos = y;
}


void oled_putxy2(char c) {
  uint8_t i, font_c;
  if((c < ' ') || (c > '~'))
    c = '?';
  oled_Command(SSD1306_COLUMNADDR);
  oled_Command(6 * (x_pos - 1));
  oled_Command(6 * (x_pos - 1) + 4); // Column end address (127 = reset)

  oled_Command(SSD1306_PAGEADDR);
  oled_Command(y_pos - 1); // Page start address (0 = reset)
  oled_Command(y_pos - 1); // Page end address
  
  i2c_start();
  i2c_write(oled_address);
  i2c_write(0x40);
  
  for(i = 0; i < 5; i++ ) {
    font_c = Font[(c - 32) * 5 + i];
  
    i2c_write(font_c);
  }
  i2c_stop();

  #if defined SSD1306_128_64 || defined SSD1306_128_32
  x_pos = x_pos % 21 + 1;
  if (wrap && (x_pos == 1))
    #if defined SSD1306_128_64
      y_pos = y_pos % 8 + 1;
    #else
      y_pos = y_pos % 4 + 1;
    #endif

  #else
    x_pos = x_pos % 16 + 1;
    if (wrap && (x_pos == 1))
      y_pos = y_pos % 2 + 1;
  #endif

}


void oled_printxy2(char *s) {
  uint8_t i = 0;
  while (s[i] != '\0'){
    if (s[i] == ' ' & x_pos == 1)
      i++;
    else
      oled_putxy2(s[i++]);
  }
}
